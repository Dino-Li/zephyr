## boards/ite/it513xx_evb/Kconfig.defconfig
```kconfig
# Copyright (c) 2024 ITE Corporation. All Rights Reserved.
# SPDX-License-Identifier: Apache-2.0

if BOARD_IT513XX_EVB

if PM

config PM_DEVICE
	default y

choice PM_POLICY
	default PM_POLICY_CUSTOM
endchoice

endif # PM

endif # BOARD_IT513XX_EVB
```

## boards/ite/it513xx_evb/Kconfig.it513xx_evb
```kconfig
# Copyright (c) 2024 ITE Corporation. All Rights Reserved.
# SPDX-License-Identifier: Apache-2.0

config BOARD_IT513XX_EVB
	select SOC_IT51386CX
```

## boards/ite/it513xx_evb/board.yml
```yaml
board:
  name: it513xx_evb
  full_name: IT51XXX series
  vendor: ite
  socs:
    - name: it51386cx
```

## soc/ite/ec/it51xxx/Kconfig.soc
```kconfig
# Copyright (c) 2024 ITE Corporation. All Rights Reserved.
# SPDX-License-Identifier: Apache-2.0

config SOC_SERIES_IT51XXX
	bool
	select SOC_FAMILY_ITE_EC
	select SOC_PREP_HOOK
	help
	  Enable support for ITE IT51XXX

config SOC_IT51XXX
	bool
	select SOC_SERIES_IT51XXX

config SOC_IT51386CX
	bool
	select SOC_IT51XXX

config SOC_SERIES
	default "it51xxx" if SOC_SERIES_IT51XXX

config SOC
	default "it51386cx" if SOC_IT51386CX
```
